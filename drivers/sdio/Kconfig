## drivers/sdio/Kconfig
```kconfig
# Copyright (c) 2020 HAW Hamburg
#
# This file is subject to the terms and conditions of the GNU Lesser
# General Public License v2.1. See the file LICENSE in the top level
# directory for more details.
#

config MODULE_QSPI
    bool "QSPI driver"
    depends on HAS_PERIPH_GPIO
    depends on TEST_KCONFIG
    select MODULE_PERIPH_GPIO

menuconfig KCONFIG_USEMODULE_QSPI
    bool "Configure QSPI driver"
    depends on USEMODULE_QSPI
    help
        Configure the QSPI using Kconfig.

if KCONFIG_USEMODULE_QSPI

config QSPI_DMATRANS_MINLEN
    int "QSPI DMA transfer min length"
    default 4
    range 1 32
    help
        The min length via DMA transfer, Otherwise transfering data don't via DMA, 
        Using normal mode.
```

## drivers/st7789/Kconfig
```kconfig
# Copyright (c) 2020 HAW Hamburg
#
# This file is subject to the terms and conditions of the GNU Lesser
# General Public License v2.1. See the file LICENSE in the top level
# directory for more details.
#

config MODULE_ST7789
    bool "ST7789 display driver"
    depends on HAS_PERIPH_SPI
    depends on HAS_PERIPH_GPIO
    depends on TEST_KCONFIG
    select MODULE_PERIPH_SPI
    select MODULE_PERIPH_GPIO
    select MODULE_XTIMER

menuconfig KCONFIG_USEMODULE_ST7789
    bool "Configure ST7789 driver"
    depends on USEMODULE_ST7789
    help
        Configure the ST7789 display driver using Kconfig.
```
